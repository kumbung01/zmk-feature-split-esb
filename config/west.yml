## config/west.yml
```yaml
# Copyright (c) 2025 The ZMK Contributors
# SPDX-License-Identifier: LicenseRef-Nordic-5-Clause

manifest:
  remotes:
    - name: zmkfirmware
      url-base: https://github.com/zmkfirmware
    - name: nrfconnect
      url-base: https://github.com/nrfconnect
  projects:
    - name: zmk
      remote: zmkfirmware
      revision: main
      import: app/west.yml
    - name: sdk-nrf
      remote: nrfconnect
      revision: v2.6.4 # zephyr v3.5.99
      path: nrf
    - name: nrfxlib
      remote: nrfconnect
      revision: v2.6.4
      repo-path: sdk-nrfxlib
      path: nrfxlib
  self:
    path: config
```

## dts/bindings/zmk,esb-split.yaml
```yaml
# Copyright (c) 2025 The ZMK Contributors
# SPDX-License-Identifier: MIT

description: |
  Complete specification of ESB split connection

compatible: "zmk,esb-split"

properties:

  # These are arbitrary default addresses. In end user products
  # different addresses should be used for each set of devices.
  base-addr-0:
    type: array
    required: true
    description: "base address 0"
  base-addr-1:
    type: array
    required: true
    description: "base address 1"
  addr-prefix:
    type: array
    required: true
    description: "base address 0"
  rf-channels:
    type: array
    required: false
    description: "array of channels that keyboard will hop"
```
